## CMakeLists.txt
```
cmake_minimum_required(VERSION 3.20.0)
find_package(Zephyr REQUIRED HINTS $ENV{ZEPHYR_BASE})
project(ai_sensor_anomaly_detector)

target_sources(app PRIVATE
    src/main.c
    src/sensor.c
    src/ml_inference.c
    src/features.c
)
```

## prj.conf
```kconfig
CONFIG_CONSOLE=y
CONFIG_PRINTK=y
CONFIG_ENTROPY_GENERATOR=y
```

## src/main.c
```c
#include <zephyr/kernel.h>
#include <zephyr/sys/printk.h>

#include "features.h"
#include "ml_inference.h"
#include "sensor.h"


int main(void)
{
    int sample = 0;
    struct sensor_window window = {0};
    float features[FEATURE_COUNT];

    printk("AI Sensor Anomaly Detector\n");
    printk("Virtual embedded device starting...\n");

    while (1) {
        sample++;

        struct sensor_data data = sensor_task(sample);

        int window_index = (sample - 1) % SENSOR_WINDOW_SIZE;

        window.temperature[window_index] = data.temperature;
        window.current[window_index] = data.current;
        window.vibration[window_index] = data.vibration;

        int anomaly = anomaly_predict(
            data.temperature,
            data.current,
            data.vibration
        );

        if (sample >= SENSOR_WINDOW_SIZE &&
            window_index == SENSOR_WINDOW_SIZE - 1) {
            extract_features(&window, features);

            int feature_anomaly = anomaly_predict_features(features);

            int temp_mean = (int)(features[0] * 100.0f);
            int temp_max = (int)(features[3] * 100.0f);
            int current_mean = (int)(features[4] * 100.0f);
            int current_max = (int)(features[7] * 100.0f);
            int vibration_mean = (int)(features[8] * 100.0f);
            int vibration_max = (int)(features[11] * 100.0f);
            int vibration_rms = (int)(features[12] * 100.0f);

            printk(
                "FEATURES,temp_mean=%d.%02d,temp_max=%d.%02d,current_mean=%d.%02d,current_max=%d.%02d,vibration_mean=%d.%02d,vibration_max=%d.%02d,vibration_rms=%d.%02d\n",
                temp_mean / 100, temp_mean % 100,
                temp_max / 100, temp_max % 100,
                current_mean / 100, current_mean % 100,
                current_max / 100, current_max % 100,
                vibration_mean / 100, vibration_mean % 100,
                vibration_max / 100, vibration_max % 100,
                vibration_rms / 100, vibration_rms % 100
            );

            printk("FEATURE_ANOMALY,%d\n", feature_anomaly);
        }

        int temp = (int)(data.temperature * 100.0f);
        int current = (int)(data.current * 100.0f);
        int vibration = (int)(data.vibration * 100.0f);

        printk(
            "DATA,%d,%d.%02d,%d.%02d,%d.%02d,%d\n",
            sample,
            temp / 100, temp % 100,
            current / 100, current % 100,
            vibration / 100, vibration % 100,
            anomaly
        );

        if (sample >= 300) {
            break;
        }

        k_sleep(K_NO_WAIT);
    }

    return 0;
}
```

## src/features.c
```c
#include "features.h"

#include <math.h>

static float mean(const float *values)
{
    float sum = 0.0f;

    for (int i = 0; i < SENSOR_WINDOW_SIZE; i++) {
        sum += values[i];
    }

    return sum / SENSOR_WINDOW_SIZE;
}

static float variance(const float *values, float average)
{
    float sum = 0.0f;

    for (int i = 0; i < SENSOR_WINDOW_SIZE; i++) {
        float delta = values[i] - average;
        sum += delta * delta;
    }

    return sum / SENSOR_WINDOW_SIZE;
}

static float peak_to_peak(const float *values)
{
    float minimum = values[0];
    float maximum = values[0];

    for (int i = 1; i < SENSOR_WINDOW_SIZE; i++) {
        if (values[i] < minimum) {
            minimum = values[i];
        }

        if (values[i] > maximum) {
            maximum = values[i];
        }
    }

    return maximum - minimum;
}

static float maximum(const float *values)
{
    float result = values[0];

    for (int i = 1; i < SENSOR_WINDOW_SIZE; i++) {
        if (values[i] > result) {
            result = values[i];
        }
    }

    return result;
}

static float rms(const float *values)
{
    float sum = 0.0f;

    for (int i = 0; i < SENSOR_WINDOW_SIZE; i++) {
        sum += values[i] * values[i];
    }

    return sqrtf(sum / SENSOR_WINDOW_SIZE);
}

void extract_features(
    const struct sensor_window *window,
    float features[FEATURE_COUNT]
)
{
    float temp_mean = mean(window->temperature);
    float current_mean = mean(window->current);
    float vibration_mean = mean(window->vibration);

    features[0] = temp_mean;
    features[1] = variance(window->temperature, temp_mean);
    features[2] = peak_to_peak(window->temperature);
    features[3] = maximum(window->temperature);

    features[4] = current_mean;
    features[5] = variance(window->current, current_mean);
    features[6] = peak_to_peak(window->current);
    features[7] = maximum(window->current);

    features[8] = vibration_mean;
    features[9] = variance(window->vibration, vibration_mean);
    features[10] = peak_to_peak(window->vibration);
    features[11] = maximum(window->vibration);
    features[12] = rms(window->vibration);
}
```

## src/features.h
```c
#ifndef FEATURES_H
#define FEATURES_H

#define SENSOR_WINDOW_SIZE 10
#define FEATURE_COUNT 13

struct sensor_window {
    float temperature[SENSOR_WINDOW_SIZE];
    float current[SENSOR_WINDOW_SIZE];
    float vibration[SENSOR_WINDOW_SIZE];
};

void extract_features(
    const struct sensor_window *window,
    float features[FEATURE_COUNT]
);

#endif
```

## src/ml_inference.c
```c
#include "ml_inference.h"

int anomaly_predict(float temperature, float current, float vibration)
{
    if (temperature <= 26.51f) {
        if (current <= 5.405f) {
            if (vibration <= 1.260f) {
                return 0;
            }

            return 1;
        }

        return 1;
    }

    return 1;
}

int anomaly_predict_features(const float features[FEATURE_COUNT])
{
    /*
     * Feature-based reference classifier.
     *
     * Uses the strongest learned features from the experimental
     * Random Forest: temperature max, temperature mean,
     * current max, and vibration peak-to-peak.
     */
    if (features[3] > 26.51f) {
        return 1;
    }

    if (features[7] > 5.405f) {
        return 1;
    }

    if (features[10] > 0.60f) {
        return 1;
    }

    if (features[0] > 26.05f) {
        return 1;
    }

    return 0;
}
```

## src/ml_inference.h
```c
#ifndef ML_INFERENCE_H
#define ML_INFERENCE_H

#include "features.h"

int anomaly_predict(float temperature, float current, float vibration);

int anomaly_predict_features(const float features[FEATURE_COUNT]);

#endif
```

## src/sensor.c
```c
#include <zephyr/kernel.h>
#include <zephyr/sys/printk.h>

#include "sensor.h"

static unsigned int random_state = 0x12345678u;

static unsigned int sensor_random(void)
{
    random_state ^= random_state << 13;
    random_state ^= random_state >> 17;
    random_state ^= random_state << 5;

    return random_state;
}

static int temp_start;
static int current_start;
static int vibration_start;
static bool initialized;

static void initialize_fault_windows(void)
{
    if (initialized) {
        return;
    }

    temp_start = 20 + (sensor_random() % 61);
    current_start = 100 + (sensor_random() % 81);
    vibration_start = 200 + (sensor_random() % 61);

    initialized = true;

    printk("FAULT_WINDOWS,temp=%d,current=%d,vibration=%d\n",
           temp_start, current_start, vibration_start);
}

static int sensor_read_temperature(int sample)
{
    int noise = (int)(sensor_random() % 31) - 15;

    if (sample >= temp_start && sample < temp_start + 20) {
        return 280 + noise;
    }

    return 250 + noise;
}

static int sensor_read_current(int sample)
{
    int noise = (int)(sensor_random() % 81) - 40;

    if (sample >= current_start && sample < current_start + 10) {
        return 580 + noise;
    }

    return 500 + noise;
}

static int sensor_read_vibration(int sample)
{
    int noise = (int)(sensor_random() % 51) - 25;

    if (sample >= vibration_start && sample < vibration_start + 5) {
        return 140 + noise;
    }

    return 100 + noise;
}

struct sensor_data sensor_task(int sample)
{
    initialize_fault_windows();

    struct sensor_data data;

    int temperature = sensor_read_temperature(sample);
    int current = sensor_read_current(sample);
    int vibration = sensor_read_vibration(sample);

    data.temperature = temperature / 10.0f;
    data.current = current / 100.0f;
    data.vibration = vibration / 100.0f;

    return data;
}
```

## src/sensor.h
```c
#ifndef SENSOR_H
#define SENSOR_H

struct sensor_data {
    float temperature;
    float current;
    float vibration;
};

struct sensor_data sensor_task(int sample);

#endif
```
